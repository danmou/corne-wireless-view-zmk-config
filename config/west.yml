## config/west.yml
```yaml
manifest:
  remotes:
    - name: zmkfirmware
      url-base: https://github.com/zmkfirmware
    - name: danmou
      url-base: https://github.com/danmou
  projects:
    - name: zmk
      remote: zmkfirmware
      revision: v0.3.0
      import: app/west.yml
    - name: zmk-hid-trackball-interface
      remote: danmou
      revision: main
  self:
    path: config
```
